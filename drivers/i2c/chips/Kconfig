## drivers/i2c/chips/Kconfig
```kconfig
#
# Miscellaneous I2C chip drivers configuration
#
# *** DEPRECATED! Do not add new entries! See Makefile ***
#

menu "Miscellaneous I2C Chip support"

config DS1682
	tristate "Dallas DS1682 Total Elapsed Time Recorder with Alarm"
	depends on EXPERIMENTAL
	help
	  If you say yes here you get support for Dallas Semiconductor
	  DS1682 Total Elapsed Time Recorder.

	  This driver can also be built as a module.  If so, the module
	  will be called ds1682.

config SENSORS_TSL2550
	tristate "Taos TSL2550 ambient light sensor"
	depends on EXPERIMENTAL
	help
	  If you say yes here you get support for the Taos TSL2550
	  ambient light sensor.

	  This driver can also be built as a module.  If so, the module
	  will be called tsl2550.

# Acceleration sensor for EVE
config BOSCH_SMB380
	tristate "SMB380/BMA150 acceleration sensor support"
	depends on I2C=y
	help
	  If you say yes here you get support for Bosch Sensortec's 
	  acceleration sensors SMB380/BMA150.
# Compass sensor for EVE
config SENSORS_AK8973
	tristate "AK8973 compass sensor support "
	depends on I2C
	help
	  If you say yes here you get support for Asahi Kasei's 
	  orientation sensor AK8973.
	  
config SENSORS_PCA963X
	tristate "Philips PCA963X 4-bit I2C-bus LED"
	depends on I2C && EXPERIMENTAL
	help
	 If you say yes here you get support for the Philips PCA963X
	 4-bit I2C-bus LED.

	 This driver can also be built as a module.  If so, the module
	 will be called pca963X.

config SENSORS_MT9T013
	tristate "MT9T013 Camera Driver"
	depends on I2C
	default y
	help
	 MT9T013 Camera Driver implemented by HTC.

config VP_A1026
	tristate "A1026 Voice Processor Driver"
	depends on I2C
	help
	  A1026 Voice Processor Driver implemented by HTC.

endmenu
```

## drivers/media/video/msm/Kconfig
```kconfig
menuconfig MSM_CAMERA
    bool "Qualcomm MSM camera and video capture support"
    depends on ARCH_MSM && I2C && ANDROID_PMEM
    default y
    help
      Say Y here to enable selecting the video adapters for
      Qualcomm msm camera and video encoding
comment "Camera Sensor Selection"
config MT9T013
	bool "Sensor mt9t013 (BAYER 3M)"
	---help---
	  MICRON 3M Bayer Sensor with AutoFocus

config MT9D112
	bool "Sensor mt9d112 (YUV   2M)"
	---help---
	  MICRON 2M YUV Sensor
```
